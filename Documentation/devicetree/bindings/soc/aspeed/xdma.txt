## Documentation/devicetree/bindings/soc/aspeed/xdma.txt
```
* Device tree bindings for the Aspeed XDMA Engine

The XDMA Engine embedded in the AST2500 SOC can perform automatic DMA
operations over PCI between the AST2500 (acting as a BMC) and a host processor.

Required properties:

 - compatible		"aspeed,ast2500-xdma"
 - reg			contains the offset and length of the memory region
			assigned to the XDMA registers
 - resets		reset specifier for the syscon reset associated with
			the XDMA engine
 - interrupts		the interrupt associated with the XDMA engine on this
			platform

Example:

    xdma@1e6e7000 {
        compatible = "aspeed,ast2500-xdma";
        reg = <0x1e6e7000 0x100>;
        resets = <&syscon ASPEED_RESET_XDMA>;
        interrupts = <6>;
    };
```

## drivers/soc/aspeed/Kconfig
```kconfig
menu "ASPEED SoC drivers"

config ASPEED_BMC_MISC
	bool "Miscellaneous ASPEED BMC interfaces"
	depends on ARCH_ASPEED || COMPILE_TEST
	default ARCH_ASPEED
	help
	  Say yes to expose VGA and LPC scratch registers, and other
	  miscellaneous control interfaces specific to the ASPEED BMC SoCs

config ASPEED_XDMA
	tristate "Aspeed XDMA Engine Driver"
	depends on (ARCH_ASPEED || COMPILE_TEST) && REGMAP && MFD_SYSCON && HAS_DMA
	help
	  Enable support for the Aspeed XDMA Engine found on the Aspeed AST2500
	  SOC. The XDMA engine can perform automatic PCI DMA operations between
	  the AST2500 (acting as a BMC) and a host processor.

endmenu
```
